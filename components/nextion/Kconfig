## components/nextion/Kconfig
```kconfig
menu "Nextion Display"

    config NEX_UART_MUTEX_WAIT_TIME_MS
        int "Mutex acquire wait time (ms)"
        range 10 1000
        default 500
        help
            Time, in milliseconds, to wait for a mutex to be acquired.
            Mutex is used to lock the UART and allow only one command or
            event processing to be sent.

    config NEX_UART_RECV_WAIT_TIME_MS
        int "Response wait time (ms)"
        range 10 1000
        default 200
        help
            Time, in milliseconds, to wait for a response from the display.

    config NEX_UART_TRANS_WAIT_TIME_MS
        int "Transmit wait time (ms)"
        range 10 1000
        default 200
        help
            Time, in milliseconds, to wait for a transmission from the ESP32.

    config NEX_UART_RECV_BUFFER_SIZE
        int "UART receiver buffer size (bytes)"
        range 128 1024
        default 256
        help
            The UART buffer used for receiving messages.

            Use a big size if you intend to receive a lot of event messages
            in a short time span and/or the event message processing is slow.

    config NEX_UART_TRANS_COMMAND_FORMAT_BUFFER_SIZE
        int "UART command format buffer size (bytes)"
        range 128 512
        default 128
        help
            The UART buffer used to format command before sending.
            It is used for 'vprintf' command.

            Use a big size if you intend to send big text messages.

    config NEX_UART_TASK_PRIORITY
        int "UART task priority"
        range 1 10
        default 1
        help
            The UART task priority.
            Never set it to zero or your system might never
            process the events.

endmenu # Nextion Configuration
```

## sdkconfig.defaults
```kconfig
CONFIG_NEWLIB_NANO_FORMAT=y

CONFIG_NEX_UART_MUTEX_WAIT_TIME_MS=500
CONFIG_NEX_UART_RECV_WAIT_TIME_MS=100
CONFIG_NEX_UART_TRANS_WAIT_TIME_MS=100
CONFIG_NEX_UART_RECV_BUFFER_SIZE=256
CONFIG_NEX_UART_TRANS_COMMAND_FORMAT_BUFFER_SIZE=128
```

## test/sdkconfig.defaults
```kconfig
CONFIG_NEX_UART_MUTEX_WAIT_TIME_MS=500
CONFIG_NEX_UART_RECV_WAIT_TIME_MS=100
CONFIG_NEX_UART_TRANS_WAIT_TIME_MS=100
CONFIG_NEX_UART_RECV_BUFFER_SIZE=256
CONFIG_NEX_UART_TRANS_COMMAND_FORMAT_BUFFER_SIZE=256
# CONFIG_ESP_TASK_WDT_CHECK_IDLE_TASK_CPU0 is not set
CONFIG_UNITY_ENABLE_FLOAT=y
CONFIG_UNITY_ENABLE_DOUBLE=y
CONFIG_UNITY_ENABLE_COLOR=y
CONFIG_UNITY_ENABLE_IDF_TEST_RUNNER=y
CONFIG_UNITY_ENABLE_BACKTRACE_ON_FAIL=y
```
